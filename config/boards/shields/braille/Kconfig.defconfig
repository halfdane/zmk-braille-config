## config/boards/shields/braille/Kconfig.defconfig
```kconfig
config SHIELD_BRAILLE
    def_bool $(shields_list_contains,braille)

config PWM
    default y
```

## config/dts/bindings/behaviors/pwm-rumble.yaml
```yaml
description: PWM Rumble node

compatible: "braille,pwm-rumble"

properties:
  pwms:
    type: phandle-array
    required: true

  label:
    required: false
    type: string
    description: Human readable string describing the device (used as device_get_binding() argument)
```

## config/dts/bindings/behaviors/rumble.yaml
```yaml
description: Rumble node

compatible: "zmk,rumble"

properties:
  pwms:
    type: phandle-array
    required: true

  label:
    required: false
    type: string
    description: Human readable string describing the device (used as device_get_binding() argument)
```

## config/west.yml
```yaml
manifest:
  remotes:
    - name: zmkfirmware
      url-base: https://github.com/zmkfirmware
    - name: halfdane
      url-base: https://github.com/halfdane
  projects:
    - name: zmk
      remote: zmkfirmware
      revision: main
      import: app/west.yml
    - name: zmk-behavior-haptic-feedback
      remote: halfdane
      revision: main
  self:
    path: config
```
