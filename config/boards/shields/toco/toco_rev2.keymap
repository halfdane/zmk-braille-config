// **********************
//    BRAILLE KEYBOARD
// **********************
//  Top left (TL), top right (TR), bottom left (BL) and bottom right (BR)
//  are special keys with tap dances and all kinds of fancy stuff (see SPECIAL KEYS).
//  The numbers represent the braille dots, so '1' means 'braille dot 1'
//  ╭─────────────────╮
//  │  TL         TR  │
//  │      4   1      │
//  │      5   2      │
//  │      6   3      │
//  │  BL         BR  │
//  ╰─────[on/off]────╯
// To swap the columns see DOT CONFIGURATION below

// *************
//    TIMINGS
// *************
// time to wait before consecutive taps activate tap dance 
#define TAPPING_TERM 500
// time window for combos to activate
#define COMBO_TERM 100
#include <behaviors.dtsi>
#include <dt-bindings/zmk/keys.h>
#include <dt-bindings/zmk/bt.h>
#include <dt-bindings/zmk/outputs.h>
#include "../helper.h"
&mt {
    tapping-term-ms = <TAPPING_TERM>;
};

// ***********************
//    DOT CONFIGURATION
// ***********************
#define TL 0
#define TR 1


#define D1 2
#define D2 4
#define D3 6
#define D4 3
#define D5 5
#define D6 7

#define BL 8
#define BR 9
ZMK_BEHAVIOR(BR_BOOTLOADER, macro, bindings = <&brr 2 &bootloader>;)

// short press Z, long press bootloader
ZMK_BEHAVIOR(kp_bootloader, hold_tap,
    flavor = "balanced";
    tapping-term-ms = <280>;
    quick-tap-ms = <125>;
    bindings = <&BR_BOOTLOADER>, <&kp>;
)

// ************
//    LAYERS
// ************
ZMK_LAYER(base_layer,    
&trans              &trans
    &trans  &trans
    &trans  &trans
    &trans  &trans
&trans              &trans)
#define BASE_LAYER 0

// the layers are really the same - they are just used to differentiate the combos
ZMK_LAYER(BR_NUM_LAYER, &trans)
#define NUM_LAYER 1
// helper layers that activate when the corresponding dot is pressed
ZMK_LAYER(BR_DOT4_LAYER, &trans)
#define DOT4_LAYER 2
ZMK_LAYER(BR_DOT5_LAYER, &trans)
#define DOT5_LAYER 3
ZMK_LAYER(BR_DOT6_LAYER, &trans)
#define DOT6_LAYER 4
ZMK_LAYER(BR_DOT45_LAYER, &trans)
#define DOT45_LAYER 5
ZMK_LAYER(BR_ADDITIONAL_LAYER, &trans)
#define ADDITIONAL_LAYER 6

ZMK_LAYER(BR_SETTINGS_LAYER, &trans)
#define BR_SETTINGS_LAYER 7

ZMK_LAYER(BR_NAVIGATION_LAYER, &trans)
#define BR_NAVIGATION_LAYER 8

/ {
    behaviors {
        brr: haptic_feedback {
            compatible = "zmk,behavior-haptic-feedback";
            #binding-cells = <1>;
        };
    };
};

// ***********************
//    LANGUAGE / LAYOUT
// ***********************
// include the language
#include "includes/de_de.h"
// #include "includes/de_usintl.h"

// ******************       
//    SPECIAL KEYS
// ******************
// TOP-RIGHT: tap: right / hold: Control
// hold tl and tap tr: up
ZMK_BEHAVIOR(rightup, mod_morph, mods = <(MOD_RALT)>; bindings = <&mt LCTRL RIGHT>, <&kp UP>; )
ZMK_COMBO(BR_TL_KEY,  &rightup, TL, BASE_LAYER)

// TOP-LEFT: tap: left / hold: RAlt
// hold tr and tap tl: down
ZMK_BEHAVIOR(leftdown, mod_morph, mods = <(MOD_LCTL)>; bindings = <&mt RALT LEFT>, <&kp DOWN>; )
ZMK_COMBO(BR_TR_KEY,  &leftdown, TR, BASE_LAYER)

// BOTTOM-LEFT: tap: SPACE / hold: LALT
// hold br and tap bl: backspace
ZMK_BEHAVIOR(spbacksp, mod_morph, mods = <(MOD_LSFT)>; bindings = <&mt LALT SPACE>, <&kp BACKSPACE>; )
ZMK_COMBO(BR_BL_KEY,  &spbacksp, BR, BASE_LAYER)

// BOTTOM-RIGHT: tap: ENTER / hold: LSHIFT
// hold bl and tap br: escape
ZMK_BEHAVIOR(entesc, mod_morph, mods = <(MOD_LALT)>; bindings = <&mt LSHIFT ENTER>, <&kp ESCAPE>; )
ZMK_COMBO(BR_BR_KEY,  &entesc, BL, BASE_LAYER)

// BOTTOM-LEFT and BOTTOM-RIGHT together switch to settings layer
ZMK_BEHAVIOR(BR_TO_SETTINGS_LAYER, macro, bindings = <&to BR_SETTINGS_LAYER &brr 2>;)
ZMK_COMBO(BL_BR_SETTINGS_LAYER, &BR_TO_SETTINGS_LAYER,  BL BR, BASE_LAYER)
// TOP-LEFT and TOP-RIGHT together switch to navigation layer
ZMK_BEHAVIOR(BR_TO_NAVIGATION_LAYER, macro, bindings = <&to BR_NAVIGATION_LAYER &brr 2>;)
ZMK_COMBO(TL_TR_SETTINGS_LAYER, &BR_TO_NAVIGATION_LAYER,  TL TR, BASE_LAYER)


ZMK_BEHAVIOR(BR_TO_BASE_LAYER, macro, bindings = <&to BASE_LAYER &brr 1>;)
// ********************
//    SETTINGS LAYER
// ********************
// both bottom keys return to base layer
ZMK_COMBO(BR_SETTINGS_BACK_TO_BASE, &BR_TO_BASE_LAYER,  BL BR, BR_SETTINGS_LAYER)
// top left: previous bluetooth profile
ZMK_COMBO(BR_SETTINGS_BT_PREV, &bt BT_PRV,  TL, BR_SETTINGS_LAYER)
// top right: next bluetooth profile
ZMK_COMBO(BR_SETTINGS_BT_NEXT, &bt BT_NXT,  TR, BR_SETTINGS_LAYER)
// both top keys: clear all bluetooth profiles
ZMK_COMBO(BR_SETTINGS_BT_CLEAR_ALL, &bt BT_CLR_ALL,  TL TR, BR_SETTINGS_LAYER)

// D1 and D4: switch to bootloader mode
ZMK_COMBO(BR_SETTINGS_BOOTLOADER, &bootloader,  D1 D4, BR_SETTINGS_LAYER)


// **********************
//    NAVIGATION LAYER
// **********************
// both top keys return to base layer
ZMK_COMBO(BR_NAVIGATION_BACK_TO_BASE, &BR_TO_BASE_LAYER,  TL TR, BR_NAVIGATION_LAYER)

ZMK_COMBO(navigate_to_next_item, &kp LA(RIGHT),  TL, BR_NAVIGATION_LAYER)
ZMK_COMBO(navigate_to_previous_item, &kp LA(LEFT),  TR, BR_NAVIGATION_LAYER)
ZMK_COMBO(click_current_item, &kp LA(ENTER), BR, BR_NAVIGATION_LAYER)

ZMK_COMBO(global_back, &kp LA(BACKSPACE), D1  D2, BR_NAVIGATION_LAYER)
ZMK_COMBO(global_home, &kp LA(LC(H)), D1  D2 D5, BR_NAVIGATION_LAYER)
ZMK_COMBO(reading_control_up, &kp LA(LS(UP)), D1, BR_NAVIGATION_LAYER)
ZMK_COMBO(reading_control_down, &kp LA(LS(DOWN)), D4, BR_NAVIGATION_LAYER)
ZMK_COMBO(global_talkback_pause, &kp LA(LS(Z)), D1 D4, BR_NAVIGATION_LAYER)

ZMK_COMBO(global_notifications, &kp LA(LC(N)), D1 D3 D4 D5, BR_NAVIGATION_LAYER)
ZMK_COMBO(global_recent, &kp LA(LC(R)), D1 D2 D3 D5, BR_NAVIGATION_LAYER)
ZMK_COMBO(global_previous, &kp LA(LC(UP)), D1 D2 D3 D4, BR_NAVIGATION_LAYER)
