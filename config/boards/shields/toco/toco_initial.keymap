#include <behaviors.dtsi>
#include <dt-bindings/zmk/keys.h>
#include <dt-bindings/zmk/bt.h>
#include <dt-bindings/zmk/outputs.h>
#include "../helper.h"


// **********************
//    INITIAL KEYBOARD
// **********************
// a pretty simple layout that allows testing most features on the
// blank xiao_ble with some tweezers - to test the haptic feedback,
// you obviously need to connect some kind of feedback on pin 0 - a rumble motor, an LED or a multimeter

ZMK_BEHAVIOR(BR_BOOTLOADER, macro, bindings = <&brr 2 &bootloader>;)

// short press Z, long press bootloader
ZMK_BEHAVIOR(kp_bootloader, hold_tap,
    flavor = "balanced";
    tapping-term-ms = <280>;
    quick-tap-ms = <125>;
    bindings = <&BR_BOOTLOADER>, <&kp>;
)

/ {

    keymap {
        compatible = "zmk,keymap";

        default_layer {
            bindings = <
                &kp_bootloader 0 X  &kp A  &bt BT_CLR_ALL  &out OUT_BLE
            >;
        };
    };
};

/ {
    behaviors {
        brr: haptic_feedback {
            compatible = "zmk,behavior-haptic-feedback";
            #binding-cells = <1>;
        };
    };
};