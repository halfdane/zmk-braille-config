/*
 * Copyright (c) 2020 The ZMK Contributors
 *
 * SPDX-License-Identifier: MIT
 */

/ {
    behaviors {
        /omit-if-no-ref/ rmbl: rmbl {
            compatible = "zmk,rumble";
            #binding-cells = <1>;
            bindings = <&kp>;
        };
    };
};

